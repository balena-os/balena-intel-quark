## layers/meta-resin-intel-quark/conf/layer.conf
```bitbake
BBPATH .= ":${LAYERDIR}"

BBFILES += "${LAYERDIR}/recipes-*/*/*.bb \
            ${LAYERDIR}/recipes-*/*/*.bbappend"

BBFILE_COLLECTIONS += "resin-intel-quark"
BBFILE_PATTERN_resin-intel-quark := "^${LAYERDIR}/"
BBFILE_PRIORITY_resin-intel-quark = "1337"
```
